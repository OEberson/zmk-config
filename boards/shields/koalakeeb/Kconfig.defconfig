## boards/shields/koalakeeb/Kconfig.defconfig
```kconfig
# Copyright (c) 2020 The ZMK Contributors
# SPDX-License-Identifier: MIT

if SHIELD_KOALAKEEB_LEFT

config ZMK_KEYBOARD_NAME
    default "KoalaKeeb"

config ZMK_SPLIT_ROLE_CENTRAL
    default y

endif

if SHIELD_KOALAKEEB_LEFT || SHIELD_KOALAKEEB_RIGHT

config ZMK_SPLIT
    default y

endif
```

## boards/shields/koalakeeb/Kconfig.shield
```kconfig
# Copyright (c) 2020 The ZMK Contributors
# SPDX-License-Identifier: MIT

config SHIELD_KOALAKEEB_LEFT
    def_bool $(shields_list_contains,koalakeeb_left)

config SHIELD_KOALAKEEB_RIGHT
    def_bool $(shields_list_contains,koalakeeb_right)
```
